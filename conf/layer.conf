## conf/layer.conf
```bitbake
# We have a conf and classes directory, append to BBPATH
BBPATH .= ":${LAYERDIR}"

# We have a recipes directory, add to BBFILES
BBFILES += "${LAYERDIR}/recipes-*/*.bb ${LAYERDIR}/recipes-*/*.bbappend \
            ${LAYERDIR}/recipes-*/*/*.bb ${LAYERDIR}/recipes-*/*/*.bbappend"

BBFILE_COLLECTIONS += "amlogic-layer"
BBFILE_PATTERN_amlogic-layer := "^${LAYERDIR}/"
BBFILE_PRIORITY_amlogic-layer = "7"

OEA-META-AMLOGIC-BASE := '${@os.path.normpath("${LAYERDIR}/")}'
```

## conf/machine/include/amlogic.inc
```bitbake
IMAGE_CLASSES += "sdcard_image-aml"
PREFERRED_PROVIDER_virtual/libgles1 = "mali"
PREFERRED_PROVIDER_virtual/libgles2 = "mali"
PREFERRED_PROVIDER_virtual/egl = "mali"

PREFERRED_PROVIDER_jpeg = "libjpeg-turbo"
PREFERRED_PROVIDER_jpeg-native = "libjpeg-turbo-native"
```

## conf/machine/s905.conf
```bitbake
#@TYPE: Machine
#@NAME: S905
#@DESCRIPTION: Machine configuration for the AmLogic S905 devices

MACHINE_NAME = "generic"
BRAND_OEM = "s905"
MACHINE_BRAND = "AmLogic"

GST_VERSION = "0.10"

# Amlogic defaults
require conf/machine/include/amlogic.inc

EXTRA_OECONF_append_pn-enigma2 = " --with-alsa --with-alsacard=hw:0 --with-alsamixer=Master --with-lcddev=/dev/null --with-amlogic --with-boxtype=wetek"
DEPENDS_append_pn-enigma2 = " libdvbcsa libamcodec libamadec"
CC_append_pn-showiframe = " -DHAVE_AMLOGIC -I${STAGING_INCDIR}/amlogic/amcodec -lamcodec"
DEPENDS_append_pn-showiframe = " libamcodec"


DVBPROVIDER = "kernel"

#MACHINE_ESSENTIAL_EXTRA_RRECOMMENDS = "\
#    "

MACHINE_ESSENTIAL_EXTRA_RDEPENDS = "\
    gst-amlavsink \
    gst-app \
    gst-amlavout \
    gst-fluendo-mpegdemux \
    mali-r6p1 \
    "


MACHINE_EXTRA_RRECOMMENDS = " \
    kernel-module-stb-procfs \
    kernel-module-stb-nimsockets \
    kernel-module-sysfillrect \
    kernel-module-syscopyarea \
    kernel-module-mceusb \
    kernel-module-rc-core \
    amlsetfb \
    amremote \
    libamplayer \
    libamavutils \
    libamadec \
    libamcodec \
    mali-r6p1 \
    libdvbcsa \
    ntfs-3g \
    parted \
    mc \
    udpxy \
    enigma2-plugin-extensions-mediaplayer \
    "

include conf/machine/include/autoload-filesystems.inc

KERNEL_MODULE_AUTOLOAD += "\
    stb-procfs \
    sysfillrect \
    syscopyarea \
    mceusb \
    rc-core \
    mali \
    dhd \
    CH341 \
    rfcomm \
    hidp \
"

# Uncomment the following line to enable the hard floating point abi. Note that
# this breaks some binary libraries and 3D (neither of which ship with
# meta-yocto). For maximum compatibility, leave this disabled.
# DEFAULTTUNE ?= "cortexa9hf-neon"
include conf/machine/include/arm/arch-armv8.inc

IMAGE_FSTYPES += "ext4 aml-sdimg"
IMAGE_ROOTFS_SIZE = "976562"
IMAGE_EXTRA_SPACE = "0"
IMAGE_OVERHEAD_FACTOR = "1.0"

# Serial console to be used
SERIAL_CONSOLE = "115200 ttyS0"

PREFERRED_PROVIDER_virtual/kernel = "linux-amlogic"
PREFERRED_VERSION_linux-amlogic = "3.14.63"

KERNEL_IMAGETYPE = "Image"
KERNEL_DEVICETREE = "wetekplay.dtd"

UBOOT_ENTRYPOINT  = "0x80008000"
UBOOT_LOADADDRESS = "0x80008000"

IMAGEDIR ?= "${MACHINE}"

IMAGE_CMD_aml-sdimg_append = " \
    mkdir -p ${DEPLOY_DIR_IMAGE}/${IMAGEDIR}; \
    mv ${DEPLOY_DIR_IMAGE}/${IMAGE_NAME}.rootfs.aml-sd.img ${DEPLOY_DIR_IMAGE}/${IMAGEDIR}/${IMAGE_NAME}.sdcard.img; \
    echo ${IMAGE_VER_STRING} > ${DEPLOY_DIR_IMAGE}/${IMAGEDIR}/imageversion; \
    cd ${DEPLOY_DIR_IMAGE}; \
    zip ${DISTRO_NAME}-${DISTRO_VERSION}-${MACHINE}_sdcard.zip ${IMAGEDIR}/*; \
#    rm -f ${DEPLOY_DIR_IMAGE}/*.ext4; \
#    rm -f ${DEPLOY_DIR_IMAGE}/*.manifest; \
#    rm -f ${DEPLOY_DIR_IMAGE}/.ext4; \
#    rm -f ${DEPLOY_DIR_IMAGE}/.manifest; \
#    rm -f ${DEPLOY_DIR_IMAGE}/.aml-sd.img; \
#    rm -f ${DEPLOY_DIR_IMAGE}/*.rootfs.aml-sd.img; \
#    rm -Rf ${IMAGEDIR}; \
    "

MACHINE_FEATURES = "fb meson6 usbhost vfat alsa legacykernel nolcd"

# We know about rtc
include conf/machine/include/build-extras.inc
```
